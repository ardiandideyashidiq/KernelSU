## kernel/Kconfig
```kconfig
menu "KernelSU"

config KSU
	tristate "KernelSU function support"
	depends on KPROBES && EXT4_FS
	default y
	help
	  Enable kernel-level root privileges on Android System.
	  Requires CONFIG_KPROBES for kernel hooking support.
	  Requires CONFIG_EXT4_FS for `ext4_unregister_sysfs`.
	  To compile as a module, choose M here: the
	  module will be called kernelsu.

config KSU_NON_ANDROID
	bool "KernelSU for non-Android Linux distributions"
	depends on KSU && KALLSYMS
	default y
	help
	  Enable running KernelSU on non-Android Linux
	  distributions.
	  This will disable PID=1 checker.
	  Consider enabling this when targetting Waydroid.

config KSU_SELINUX
	bool "SELinux for KernelSU"
	depends on KSU && SECURITY_SELINUX
	default n
	help
	  Enable SELinux for KernelSU.
	  Requires CONFIG_SECURITY_SELINUX to work.

config KSU_HANDLE_INPUT_EVENT
	bool "KernelSU handle input events using Kprobes"
	depends on KSU
	default n
	help
	  Enable input events handling for KernelSU via Kprobes.
	  This only checks for KEY_VOLUMEDOWN. Since most of x86
	  devices does not have KEY_VOLUMEDOWN, this is unneeded.

config KSU_DEBUG
	bool "KernelSU debug mode"
	depends on KSU
	default n
	help
	  Enable KernelSU debug mode.

config KSU_DISABLE_MANAGER
	bool "Disable KernelSU manager integration"
	depends on KSU
	default n
	help
	  Disable manager APK detection and manager-specific handling.
	  Root will be used in place of manager-only functionality.

config KSU_DISABLE_POLICY
	bool "Disable KernelSU policy profiles"
	depends on KSU
	default n
	help
	  Disable per-app root/non-root profile customization.
	  Escalation will always use the default full root profile, and
	  non-root handling will follow the global umount policy only.

endmenu
```
